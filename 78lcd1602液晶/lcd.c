/**************************************************************************************
*		              LCD1602液晶显示实验												  *
实现现象：下载程序后插上LCD1602液晶在开发板上，即可显示
注意事项：如果不想让点阵模块显示，可以将74HC595模块上的JP595短接片拔掉。
带不带转接板的程序相同，现在集成在显示屏下面
***************************************************************************************/

#include "reg52.h"			 //此文件中定义了单片机的一些特殊功能寄存器
#include "1602.h"

typedef unsigned int u16;	  //对数据类型进行声明定义
typedef unsigned char u8;

u8 Disp1[]=" Pechin Science ";//带上空格十六位；
u8 Disp2[]=" pECHIN sCIENCE ";

/*******************************************************************************
* 函 数 名         : main
* 函数功能		   : 主函数
* 输    入         : 无
* 输    出         : 无
*******************************************************************************/
void main(void)
{
	u8 i;
	LcdInit();
	//第一行
	LcdWriteCom(0x80);
	for(i=0;i<16;i++)
	{
		LcdWriteData(Disp1[i]);	
	}
	//写入后，即可显示，不需要一直循环，显示屏上自动转换256个ASII码
	//默认写入第一行
	//写入第二行需要重新定义光标，还要开启两行显示的初始化
	LcdWriteCom(0xC0);//光标定位第二行
	for(i=0;i<16;i++)
	{
		LcdWriteData(Disp2[i]);	
	}
	Lcd1602_Delay1ms(500);
	while(1)
	{
		//移动失败
//		//移动准备
//		LcdWriteCom(0x80+16);
//		for(i=0;i<16;i++)
//		{
//			LcdWriteData(Disp1[i]);	
//		}
//		//开始移动
//		for(i=0; i<16; i++)
//		{
//			LcdWriteData(0x18); //左移
//			Lcd1602_Delay1ms(500);
//			for(i=0;i<16;i++)
//			{
//				LcdWriteData(Disp1[i]);	
//			}
//		}
//		//移动后显示
//		LcdWriteCom(0x80);
	}		
}
